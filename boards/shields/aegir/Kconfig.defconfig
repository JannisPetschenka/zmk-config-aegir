## boards/shields/aegir/Kconfig.defconfig
```kconfig
# Copyright (c) 2022 The ZMK Contributors
# SPDX-License-Identifier: MIT

if SHIELD_AEGIR_DONGLE

config ZMK_KEYBOARD_NAME
    default "AEGIR"

config ZMK_SPLIT_ROLE_CENTRAL
    default y

config ZMK_SPLIT_BLE_CENTRAL_PERIPHERALS
    default 2

config BT_MAX_CONN
    default 3

config BT_MAX_PAIRED
    default 3

config ZMK_USB
    default y

config ZMK_SPLIT
    default y

endif

if SHIELD_AEGIR_LEFT || SHIELD_AEGIR_RIGHT

config ZMK_SPLIT
    default y

config ZMK_SPLIT_ROLE_CENTRAL
    default n

endif
```

## boards/shields/aegir/Kconfig.shield
```kconfig
config SHIELD_AEGIR_LEFT
    def_bool $(shields_list_contains, aegir_left)

config SHIELD_AEGIR_RIGHT
    def_bool $(shields_list_contains, aegir_right)
```

## config/boards/shields/aegir/Kconfig.defconfig
```kconfig
# Copyright (c) 2022 The ZMK Contributors
# SPDX-License-Identifier: MIT

if SHIELD_AEGIR_CENTRAL_DONGLE || SHIELD_AEGIR_CENTRAL_LEFT
config ZMK_KEYBOARD_NAME
    default "AEGIR"

config ZMK_SPLIT_ROLE_CENTRAL
    default y

config ZMK_SPLIT_BLE_CENTRAL_PERIPHERALS
    default 2

config BT_MAX_CONN
    default 3

config BT_MAX_PAIRED
    default 3
endif

if SHIELD_AEGIR_CENTRAL_DONGLE || SHIELD_AEGIR_CENTRAL_LEFT || SHIELD_AEGIR_PERIPHERAL_LEFT || SHIELD_AEGIR_PERIPHERAL_RIGHT

config ZMK_SPLIT
    default y

endif
```

## config/boards/shields/aegir/Kconfig.shield
```kconfig
# Copyright (c) 2022 The ZMK Contributors
# SPDX-License-Identifier: MIT

config SHIELD_AEGIR_CENTRAL_DONGLE
    def_bool $(shields_list_contains,aegir_central_dongle)

config SHIELD_AEGIR_CENTRAL_LEFT
    def_bool $(shields_list_contains,aegir_central_left)

config SHIELD_AEGIR_PERIPHERAL_LEFT
    def_bool $(shields_list_contains,aegir_peripheral_left)

config SHIELD_AEGIR_PERIPHERAL_RIGHT
    def_bool $(shields_list_contains,aegir_peripheral_right)
```

## config/west.yml
```yaml
manifest:
  remotes:
    # - name: zmkfirmware
    #   url-base: https://github.com/zmkfirmware
    - name: zmkfirmware
      url-base: https://github.com/Genteure
    - name: rschenk
      url-base: https://github.com/rschenk
  projects:
    - name: zmk
      remote: zmkfirmware
      revision: feat/battery-reporting
      # revision: main
      import: app/west.yml
    - name: zmk-component-raytac-dongle
      remote: rschenk
      revision: main
  self:
    path: config
```
